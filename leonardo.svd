# Arduino_Leonardo register map
Vendor: Arduino LLC; File version: 0.1
CPU: Atmega32u4 r0p0, little endian, no MPU, FPU, 8 interrupt priority bits
Registers are 8-bit, read-write, reset 0x0 unless marked. A register's access mark holds for its fields unless they carry their own. Offsets are from the block's base; lines under a group give offsets from that group; [hi:lo] are bit positions; {n}, {i} and the like mark numbered series; 'fields as' and 'values as' point back to an identical list; <NAME> marks a mode.

## Memory map
0x00000027 IOC size 0x2

## IOC
Base 0x00000027
0x00 DDRC — Port C direction control
0x01 PORTC — Port C values
